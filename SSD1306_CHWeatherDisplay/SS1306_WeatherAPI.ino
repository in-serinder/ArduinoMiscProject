#include <ESP8266WiFi.h>
#include <Wire.h>
// #include <WiFiClientSecure.h>
#include <string.h>

#include <ESP8266HTTPClient.h> //开发板版本头文件名不一
#include <ArduinoJson.h>
#include <Adafruit_GFX.h>
#include <Adafruit_SSD1306.h>

#define LENGTH(arr) (sizeof(arr) / sizeof(arr[0]))

#define OLED_ADDR 0x3C
#define OLED_HEIGHT 64
#define OLED_WIDTH 128
#define OLED_RESET -1

#define SDA D6
#define SCL D7

#define WEATHERTEXTLEN 6
#define CHINESEARRLEN 27
#define WEATHERUPDATEHOURSDELAY 3 // 更新间隔(小时)

const char *WIFI_SSID = "2.4GHZ";
const char *WIFI_PASSWORD = "wifiPWD";

const char *API_REQUESTURL = "http://restapi.amap.com/v3/weather/weatherInfo?";
const char *API_KEY = "APIKEY";
const char *CITY_CODE = "CITYZONECODE";

const unsigned char Chinese_Arr[CHINESEARRLEN][32] = {
    {0x00, 0x00, 0x00, 0x20, 0x03, 0xFE, 0x78, 0x20, 0x49, 0xFC, 0x48, 0x20, 0x4B, 0xFE, 0x78, 0x00,
     0x49, 0xFC, 0x49, 0x04, 0x49, 0xFC, 0x79, 0x04, 0x49, 0xFC, 0x41, 0x04, 0x01, 0x0C, 0x01, 0x08}, /*"晴",0*/
    {0x00, 0x00, 0x00, 0x00, 0x1F, 0xF8, 0x00, 0x00, 0x00, 0x00, 0x00, 0x00, 0x7F, 0xFE, 0x7F, 0xFE,
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     0x61, 0x80, 0x01, 0x98, 0x01, 0xB0, 0x00, 0x60, 0x00, 0xC0, 0x07, 0x00, 0x3C, 0x00, 0x00, 0x00}, /*"少",1*/

};

const unsigned char Symbol_Arr[3][32] = {
    {0x00, 0x00, 0x20, 0x00, 0x50, 0x00, 0x50, 0xF0, 0x23, 0x0C, 0x02, 0x04, 0x06, 0x00, 0x04, 0x00,
     0x04, 0x00, 0x04, 0x00, 0x04, 0x04, 0x06, 0x04, 0x03, 0x0C, 0x01, 0xF8, 0x00, 0x00, 0x00, 0x00}, /*"℃",0*/
    {0x00, 0x00, 0x20, 0x00, 0x50, 0x00, 0x53, 0xFE, 0x23, 0x00, 0x03, 0x00, 0x03, 0x00, 0x03, 0x00,
     0x03, 0xF8, 0x03, 0x00, 0x03, 0x00, 0x03, 0x00, 0x03, 0x00, 0x00, 0x00, 0x00, 0x00, 0x00, 0x00}, /*"℉",1*/
    {0x00, 0x00, 0x00, 0x00, 0x00, 0x04, 0x00, 0x38, 0x01, 0xC0, 0x0E, 0x00, 0x30, 0x00, 0x0E, 0x00,
     0x01, 0xC0, 0x20, 0x38, 0x1C, 0x04, 0x03, 0x80, 0x00, 0x70, 0x00, 0x0C, 0x00, 0x00, 0x00, 0x00}, /*"≤",2*/

};

const unsigned char Weather_IconArr[19][32] = {
    {0x00, 0x00, 0x00, 0x00, 0x00, 0x00, 0x01, 0xf0, 0x0f, 0xf8, 0x1f, 0xf8, 0x3f, 0xfc, 0x7f, 0xfe,
     0xff, 0xff, 0xff, 0xff, 0xff, 0xff, 0x7f, 0xfe, 0x3f, 0xfe, 0x00, 0x00, 0x00, 0x00, 0x00, 0x00}, // 多云
    {
        0x00, 0x00, 0x00, 0x00, 0x00, 0x00, 0x03, 0x80, 0x0f, 0xc0, 0x0f, 0xc0, 0x1f, 0xf0, 0x3f, 0xfc,
        0x3f, 0xfc, 0x3f, 0xfc, 0x1f, 0xf8, 0x00, 0x00, 0x00, 0x00, 0x00, 0x00, 0x00, 0x00, 0x00, 0x00}, // 闪电
    {
        0x00, 0x00, 0x00, 0x00, 0x00, 0x00, 0x03, 0x80, 0x0f, 0xc0, 0x0f, 0xc0, 0x1f, 0xf0, 0x3f, 0xfc,
        0x3f, 0xfc, 0x3f, 0xfc, 0x1f, 0xf8, 0x00, 0x00, 0x00, 0x00, 0x00, 0x00, 0x00, 0x00, 0x00, 0x00}, // 大雪
    {
        0x00, 0x00, 0x00, 0x00, 0x00, 0x00, 0x3f, 0xfc, 0x00, 0x00, 0x3f, 0xfc, 0x00, 0x00, 0x3f, 0xfc,
        0x00, 0x00, 0x00, 0x40, 0x00, 0x00, 0x09, 0x10, 0x00, 0x00, 0x02, 0x40, 0x00, 0x00, 0x00, 0x00}, // 雾霾
    {
        0x00, 0x00, 0x00, 0x00, 0x00, 0x00, 0x03, 0x80, 0x0f, 0xc0, 0x0f, 0xc0, 0x1f, 0xf0, 0x3f, 0xfc,
        0x3f, 0xfc, 0x3f, 0xfc, 0x1f, 0xf8, 0x00, 0x00, 0x00, 0x00, 0x00, 0x00, 0x00, 0x00, 0x00, 0x00}, // 雾
    {
        0x00, 0x00, 0x00, 0x00, 0x00, 0x00, 0x03, 0x80, 0x0f, 0xc0, 0x0f, 0xc0, 0x1f, 0xf8, 0x3f, 0xfc,
        0x3f, 0xfc, 0x3f, 0xfc, 0x1f, 0xf8, 0x00, 0x00, 0x08, 0x10, 0x08, 0x10, 0x00, 0x00, 0x00, 0x00}, // 雨夹雪
    {
        0x00, 0x00, 0x00, 0x00, 0x00, 0x00, 0x00, 0x00, 0x01, 0xe0, 0x00, 0xf0, 0x0f, 0x70, 0x1f, 0xbe,
        0x3f, 0x8f, 0x7f, 0xf7, 0xff, 0xfb, 0xff, 0xf8, 0xff, 0xf8, 0x7f, 0xf8, 0x00, 0x00, 0x00, 0x00}, // 阴
    {
        0x00, 0x00, 0x00, 0x00, 0x00, 0x00, 0x03, 0x80, 0x0f, 0xc0, 0x0f, 0xc0, 0x1f, 0xf8, 0x3f, 0xfc,
        0x3f, 0xfc, 0x3f, 0xfc, 0x1f, 0xf8, 0x00, 0x00, 0x09, 0x90, 0x09, 0x90, 0x00, 0x00, 0x00, 0x00}, // 大雨
    {
        0x00, 0x00, 0x00, 0x00, 0x00, 0x00, 0x03, 0x80, 0x07, 0xc0, 0x0f, 0xc0, 0x1f, 0xf8, 0x3f, 0xfc,
        0x3f, 0xfc, 0x3f, 0xfc, 0x1f, 0xf8, 0x00, 0x00, 0x09, 0x80, 0x0d, 0xb0, 0x00, 0x00, 0x00, 0x00}, // 冰雹
    {
        0x00, 0x00, 0x00, 0x00, 0x00, 0x00, 0x34, 0x00, 0x34, 0x18, 0x2c, 0x30, 0x24, 0x60, 0x00, 0xc0,
        0x01, 0x80, 0x03, 0x00, 0x06, 0x18, 0x0c, 0x18, 0x18, 0x3c, 0x10, 0x2c, 0x00, 0x00, 0x00, 0x00}, // 未知
    {
        0x00, 0x00, 0x00, 0x00, 0x00, 0x20, 0x01, 0x04, 0x00, 0x7c, 0x00, 0x78, 0x0f, 0x7f, 0x1f, 0xb8,
        0x3f, 0x88, 0x7f, 0xf0, 0xff, 0xf8, 0xff, 0xf8, 0xff, 0xf8, 0x7f, 0xf8, 0x00, 0x00, 0x00, 0x00}, // 多云
    {
        0x00, 0x00, 0x00, 0x10, 0x00, 0x04, 0x00, 0x02, 0x00, 0x02, 0x00, 0x02, 0x3f, 0xc2, 0x00, 0x04,
        0x0f, 0xf0, 0x00, 0x00, 0x00, 0xc0, 0x00, 0x20, 0x00, 0x00, 0x00, 0x20, 0x00, 0x40, 0x00, 0x00}, // 风
    {
        0x00, 0x00, 0x00, 0x00, 0x20, 0x04, 0x10, 0x08, 0x03, 0xc0, 0x07, 0xe0, 0x0f, 0xf0, 0x0f, 0xf0,
        0x0f, 0xf0, 0x0f, 0xf0, 0x07, 0xe0, 0x03, 0xc0, 0x10, 0x08, 0x20, 0x04, 0x01, 0x00, 0x00, 0x00}, // 晴
    {
        0x00, 0x00, 0x01, 0x00, 0x03, 0x80, 0x03, 0x80, 0x07, 0xc0, 0x07, 0xc0, 0x0f, 0xe0, 0x0f, 0xe0,
        0x0f, 0xf0, 0x1f, 0xf0, 0x1f, 0xf8, 0x3f, 0xf8, 0x3c, 0x7c, 0x70, 0x1c, 0x60, 0x06, 0x00, 0x00}, // 风力
    {
        0xc0, 0x00, 0x70, 0x00, 0x7c, 0x0e, 0x7f, 0xfe, 0x78, 0x4c, 0x60, 0x40, 0x00, 0x40, 0x00, 0x40,
        0x00, 0xc0, 0x00, 0xe0, 0x00, 0xe0, 0x00, 0xe0, 0x00, 0xe0, 0x00, 0xe0, 0x00, 0xe0, 0x00, 0xc0}, // 风向
    {
        0x00, 0x00, 0x00, 0x00, 0x00, 0x00, 0x00, 0x30, 0x00, 0x78, 0x00, 0xd0, 0x01, 0xa0, 0x03, 0x40,
        0x0e, 0x80, 0x1d, 0x10, 0x12, 0x38, 0x1e, 0x28, 0x0c, 0x38, 0x00, 0x00, 0x00, 0x00, 0x00, 0x00}, // 湿度
    {
        0x03, 0xc0, 0x03, 0xc0, 0x06, 0x60, 0x06, 0x60, 0x06, 0x60, 0x06, 0x60, 0x06, 0x60, 0x06, 0x60,
        0x0c, 0x20, 0x0d, 0xb0, 0x19, 0x90, 0x1b, 0xd8, 0x19, 0x98, 0x0c, 0x30, 0x07, 0xe0, 0x03, 0xc0}, // 温度
    {
        0x00, 0x00, 0x01, 0x80, 0x03, 0xc0, 0x07, 0xe0, 0x07, 0x60, 0x0f, 0x70, 0x0f, 0x70, 0x1f, 0x78,
        0x1f, 0x78, 0x3f, 0x7c, 0x7f, 0xfe, 0x7f, 0xfe, 0xff, 0x7f, 0xff, 0xff, 0x7f, 0xff, 0x00, 0x00}, // 警告
    {
        0x00, 0x00, 0x3f, 0x80, 0x00, 0x00, 0x00, 0x00, 0x0a, 0x00, 0x0a, 0xc0, 0x00, 0x70, 0x00, 0x0e,
        0x0a, 0x06, 0x00, 0xe0, 0x00, 0xc0, 0x0e, 0xe0, 0x0a, 0xc0, 0x0a, 0x00, 0x7f, 0xfe, 0x00, 0x00 // 城市
    }

};

const String Chinese_index[CHINESEARRLEN] = {"晴", "云", "风", "阴", "雨", "雾", "霾", "雷", "冰", "雪", "尘", "特", "大", "中", "小", "静", "暴", "夹",
                                             "东", "南", "西", "北", "无", "不", "定", "多", ""};

const String Symbol_index[3] = {"℃", "℉", "≤"};

const String Weather_IconIndex[17] = {"云", "电", "雪", "霾", "雾", "夹", "阴", "雨", "冰", "未", "多", "风", "晴天", "力", "向", "湿", "温"};

WiFiClient wc;
Adafruit_SSD1306 display(OLED_WIDTH, OLED_HEIGHT, &Wire, OLED_RESET);
// WiFiClientSecure wc;

String Weather_Status;
String Weather_Temperature;
String Weather_Humidity;
String Weather_WindPower;
String Weather_WindDirection;
String Weather_ReportTime;

uint8_t pageflag = 0;
uint8_t weather_textlen = 0;
int timecount, Weather_updateCount;
bool WeatherFlag = false;
uint8_t weather_iconindex;
uint8_t weather_statusindexarr[WEATHERTEXTLEN], weather_directionarr[4];

String RequestURL = String(API_REQUESTURL) + "city=" + String(CITY_CODE) + "&key=" + String(API_KEY);

void Wifi_connect()
{
  int count = 0;
  WiFi.mode(WIFI_STA);
  WiFi.disconnect();
  WiFi.begin(WIFI_SSID, WIFI_PASSWORD);
  Serial.println("Connect to: \n\tSSID:" + String(WIFI_SSID) + "\n\tPassWord:" + String(WIFI_PASSWORD));
  while (WiFi.status() != WL_CONNECTED)
  {
    Serial.print('.');
    delay(1000);
    count++;
  }

  Serial.println("\nConnect to " + String(WIFI_SSID) + " Successful\n");
  Serial.println("\nMAC: " + WiFi.macAddress() + "\nIP: " + WiFi.localIP().toString() + "\nUsing Time:" + count + "s");
  display.setCursor(0, 10);
  display.printf("IP: %s \n ", WiFi.localIP().toString().c_str()); // lol
  display.setCursor(0, 20);
  display.printf("Using: %d S", count);
  display.display();
}

void displayDrawCharacter(int x, int y, const unsigned char *data)
{
  for (int i = 0; i < 16; i++)
  {
    for (int j = 0; j < 8; j++)
    {
      if (data[i * 2] & (0x80 >> j))
      {
        display.drawPixel(x + j, y + i, WHITE);
      }
    }
    for (int j = 0; j < 8; j++)
    {
      if (data[i * 2 + 1] & (0x80 >> j))
      {
        display.drawPixel(x + j + 8, y + i, WHITE);
      }
    }
  }
}

uint8_t getChineseLength(String ch)
{
  uint8_t count = 0;
  for (int i = 0; i < ch.length();)
  {
    char c = ch.charAt(i);
    int charBytes = 1;

    if ((c & 0xF8) == 0xF0)
      charBytes = 4;
    else if ((c & 0xF0) == 0xE0)
      charBytes = 3;
    else if ((c & 0xE0) == 0xC0)
      charBytes = 2;

    count++;        // 统计
    i += charBytes; // 跳过当前字符的所有字节
  }
  return count;
}

// 目标字符串，映射数组，映射数组长度，中文是否，索引数组，索引长度
uint8_t getMapArr_index(String ch, const String arr[], uint8_t arrSize, bool ischinese, uint8_t *indices, uint8_t maxIndices)
{
  uint8_t foundCount = 0;
  int i = 0;

  while (i < ch.length() && foundCount < maxIndices)
  {
    // 提取当前字符（处理UTF-8多字节字符）
    char c = ch.charAt(i);
    int charBytes = 1; // 中文占位

    if ((c & 0xF8) == 0xF0)
      charBytes = 4;
    else if ((c & 0xF0) == 0xE0)
      charBytes = 3;
    else if ((c & 0xE0) == 0xC0)
      charBytes = 2;

    // 提取完整的字符
    String currentChar = "";
    for (int j = 0; j < charBytes && i + j < ch.length(); j++)
    {
      currentChar += ch.charAt(i + j);
    }
    Serial.println("当前提取：");
    Serial.println(currentChar);

    bool found = false;
    for (uint8_t idx = 0; idx < arrSize; idx++)
    {
      if (arr[idx] == currentChar)
      {
        indices[foundCount++] = idx;
        found = true;
        break;
      }
    }

    if (!found)
    {
      Serial.print("UnFound: ");
      Serial.println(currentChar);
    }

    // 移动到下一个字符
    i += charBytes;
  }

  return foundCount;
}

void getAPIData(String url)
{
  Serial.println(url);
  if (WiFi.status() == WL_CONNECTED)
  {
    HTTPClient http;
    // 关键：使用WiFiClientSecure和HTTPS URL初始化
    Serial.println("http begin");
    http.begin(wc, url);
    Serial.println("Get api");
    int Rcode = http.GET(); // get方式 修改http非ssl

    if (Rcode > 0)
    {
      Serial.println("Status code: " + String(Rcode));
      if (Rcode = HTTP_CODE_OK)
      { // 200
        Serial.printf("Code: %d Get Weather Successfully\n", Rcode);
        String payload = http.getString();
        Serial.println(payload);
        getWeatherInfofromJson(payload);
      }
      else
      {
        Serial.printf("err %s\n", http.errorToString(Rcode).c_str());
      }
      http.end();
    }
    else
    {
      Serial.println("Fuck");
      Serial.println(Rcode);
      Serial.println(http.getString());
    }
  }
}

void getWeatherInfofromJson(String returndata)
{
  const size_t capacity = 9 * JSON_ARRAY_SIZE(9) + 9 * JSON_OBJECT_SIZE(9) + 64;
  // const size_t capacity = JSON_ARRAY_SIZE(1) + JSON_OBJECT_SIZE(5) + JSON_OBJECT_SIZE(12) + 1024;
  // 最多九个数组，每个数组9个元素
  // 如果九个对象，每个对象包含一个键值
  // 64预留
  DynamicJsonDocument doc(capacity); // 从堆中分配
  deserializeJson(doc, returndata);  // 解析
  JsonObject obj = doc["lives"][0];
  Weather_Status = obj["weather"].as<String>();
  Weather_Temperature = obj["temperature"].as<String>();
  Weather_WindDirection = obj["winddirection"].as<String>();
  Weather_WindPower = obj["windpower"].as<String>();
  Weather_Humidity = obj["humidity"].as<String>();
  Weather_ReportTime = obj["reporttime"].as<String>();

  // 此处获取文字与图片索引
  for (uint8_t i = 0; i < WEATHERTEXTLEN; i++)
  {
    uint8_t count = getMapArr_index(Weather_Status, Chinese_index, CHINESEARRLEN, Chinese_Arr, weather_statusindexarr, WEATHERTEXTLEN);
    if (count > CHINESEARRLEN)
    {
      weather_statusindexarr[i] = 255; // 错误位
    }
  }

  for (uint8_t i = 0; i < 4; i++)
  {
    uint8_t count = getMapArr_index(Weather_WindDirection, Chinese_index, CHINESEARRLEN, Chinese_Arr, weather_directionarr, 4);
    if (count > 4)
    {
      weather_directionarr[i] = 255; // 错误位
    }
  }

  WeatherFlag = true;
}

////////////////////////////////////////////
void setup()
{

  Serial.begin(9600);
  Wire.begin(SDA, SCL);
  display.begin(SSD1306_SWITCHCAPVCC, OLED_ADDR);
  display.clearDisplay();
  //
  display.setTextColor(WHITE);
  display.setTextSize(1);
  //
  display.setCursor(0, 0);
  display.printf("Connect to: %s", WIFI_SSID);

  display.display();
  Wifi_connect();
  display.setCursor(0, 30);
  display.printf("Exiting:");
  display.setCursor(25, 40);
  for (uint8_t i = 6; i > 0; i--)
  {
    display.printf("%d ", i);

    display.display();
    delay(1000);
    // display.clearDisplay();
  }
  display.clearDisplay();
  display.setTextSize(1);
  getAPIData(RequestURL);
}

void loop()
{

  display.clearDisplay();

  // put your main code here, to run repeatedly:
  if (WiFi.status() != WL_CONNECTED)
  {
    Serial.println();
    Serial.println("WiFi is break reconnect ... ");
    Wifi_connect();
  }
  else
  {
  }

  // 更新与计时器
  timecount++;
  if (timecount % 5 == 0)
  {

    pageflag++;
    if (pageflag > 2)
      pageflag = 1;
  }

  if (timecount >= 3600 * WEATHERUPDATEHOURSDELAY)
  {
    timecount = 0;
    getAPIData(RequestURL);
  }

  /*Line*/

  if (WeatherFlag)
  {
    // uint8_t indexlen = getChineseLength(Weather_Status);
    //   uint8_t indexarr[indexlen] String ch = Weather_Status;
    // uint8_t n = getChineseLength(ch);
    // uint8_t indices[n];
    // uint8_t count = getMapArr_index(ch, Chinese_index, 25, true, indices, n);
    // for (int i = 0; i < n; i++) {
    //   Serial.println(indices[i]);
    // }
  }

  // display

  display.setCursor(3, 3);
  display.printf("%s", Weather_ReportTime.c_str());

  // WeatherFlag = true;

  /*Page 1*/
  if (pageflag == 1 && WeatherFlag)
  {

    displayDrawCharacter(2, 15, Weather_IconArr[10]); // 天气
    display.setCursor(22, 20);
    display.printf("Weather:");
    for (uint8_t i = 0; i < WEATHERTEXTLEN; i++)
    {
      if (weather_statusindexarr[i] < CHINESEARRLEN)
      {
        if (weather_statusindexarr[i] == weather_statusindexarr[i + 1])
          i++;                                                                           // 在这里跳过重复查找索引
        displayDrawCharacter(70 + (i * 18), 15, Chinese_Arr[weather_statusindexarr[i]]); // 查询
      }
    }

    displayDrawCharacter(2, 33, Weather_IconArr[16]); // 温度
    display.setCursor(22, 35);
    display.printf("Temper: %s", Weather_Temperature);
    displayDrawCharacter(90, 30, Symbol_Arr[0]); // 摄氏度

    displayDrawCharacter(2, 48, Weather_IconArr[15]); // 湿度
    display.setCursor(22, 55);
    display.printf("Humidity: %s %%", Weather_Humidity);
    display.fillRect(123, 0, 5, (timecount % 5) * 12.8, WHITE); // 显示低于预期
  }
  /*Page 2*/
  if (pageflag == 2 && WeatherFlag)
  {

    displayDrawCharacter(2, 15, Weather_IconArr[13]); // 风力
    display.setCursor(22, 20);
    String WindPower = "";
    for (uint8_t i = 0; i < Weather_WindPower.length(); i++)
    {
      if (Weather_WindPower.charAt(i) >= '0' && Weather_WindPower.charAt(i) <= '9')
      {
        WindPower += Weather_WindPower.charAt(i);
      }
    }
    // display.print("WindPower:"+(WindPower.charAt(0)<'3')?"<=");
    if (WindPower.charAt(0) <= '3')
    {
      // displayDrawCharacter(75, 15, Symbol_Arr[2]); //小于等于 //但是过大影响观感
      display.printf("WindPower: <=%s", WindPower);
    }
    else
    {
      display.printf("WindPower: %s", WindPower);
    }

    displayDrawCharacter(2, 33, Weather_IconArr[14]); // 风向
    display.setCursor(22, 38);
    display.printf("Wind.D:");
    for (uint8_t i = 0; i < 4; i++)
    {
      if (weather_directionarr[i] < CHINESEARRLEN)
      {
        if (weather_directionarr[i] == weather_directionarr[i + 1])
          i++;                                                                         // 在这里跳过重复查找索引
        displayDrawCharacter(65 + (i * 18), 33, Chinese_Arr[weather_directionarr[i]]); // 查询
      }
    }

    displayDrawCharacter(2, 48, Weather_IconArr[18]); // CITY
    display.setCursor(22, 55);
    display.printf("CityCode: %s", CITY_CODE);
    display.fillRect(123, 0, 5, (timecount % 5) * 12.8, WHITE);
  }

  if (!WeatherFlag)
  {
    displayDrawCharacter(2, 25, Weather_IconArr[17]); // 无天气数据
    display.setCursor(25, 28);
    display.print("No Weather Data!");
  }

  // displayDrawCharacter(5, 25, Weather_IconArr[27]);  //风力
  // for () {
  // }

  // Serial.printf("Weather:\n%s\n%s\n%s\n%s\n%s\nReportTime:%s\n",
  // Weather_Status,Weather_Temperature,Weather_Humidity,Weather_WindPower,Weather_WindDirection,Weather_ReportTime.c_str());
  // Serial.println(Weather_ReportTime);
  display.display();
  delay(1000);
}