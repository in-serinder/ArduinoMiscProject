#include <ESP8266WiFi.h>
// #include <ESP8266WebServer.h>
#include <string.h>
#include <stdlib.h>
#include <EEPROM.h>
#include <PubSubClient.h>
#include <LiquidCrystal_I2C.h>

#include <ThreeWire.h>
#include <RtcDS1302.h>

// #include <TM1637Display.h>

#include <TimeLib.h>
#include <WiFiUdp.h>
#include <NTPClient.h>

// 天气显示器相关
#include <ESP8266HTTPClient.h>  //开发板版本头文件名不一
#include <ArduinoJson.h>
#include <Adafruit_GFX.h>
#include <Adafruit_SSD1306.h>

#if defined(ARDUINO) && ARDUINO >= 100
#define printByte(args) write(args);
#else
#define printByte(args) print(args, BYTE);
#endif


#define LED 2

#define DS_CLK D3
#define DS_DATA D4
#define DS_RST D5

#define BackLightForce D1
#define Buzzer D2  //替换为

#define OLED_ADDR 0x3C
#define OLED_HEIGHT 64
#define OLED_WIDTH 128
#define OLED_RESET -1

#define SDA D6
#define SCL D7

#define WEATHERTEXTLEN 6  //原为6
#define CHINESEARRLEN 29
#define WEATHERUPDATEHOURSDELAY 1  //更新间隔(小时)

const char *API_REQUESTURL = "http://59.82.43.66/v3/weather/weatherInfo?";
const char *API_KEY = "key";
const char *CITY_CODE = "citycode";

// #define TM1637_CLK D6
// #define TM1637_DIO D7

// #define Buzzer D8

const char *WIFI_SSID = "2.4GHZ";
const char *WIFI_PASSWORD = "pwd";

const char *MQTT_SERVER_IP = "broker";
const int MQTT_PORT = 1883;
const char *MQTT_USER = "Relay";
const char *MQTT_PASSWORD = "password";

const char *MQTT_TOPIC = "Relay/Server_Master";
const char *DHT11_TOPIC = "Temperature/Node1";

const u32_t ZONE = 28800;  // U8

const char *NTP_SERVERS[] = { "ntp.pool.org",
                              "cn.pool.ntp.org",
                              "time.windows.com",
                              "ntp.ntsc.ac.cn",
                              "203.107.6.88" };  //无法通过dns解析通过udp




const unsigned char Chinese_Arr[CHINESEARRLEN][32] = {
  { 0x00, 0x00, 0x00, 0x20, 0x03, 0xFE, 0x78, 0x20, 0x49, 0xFC, 0x48, 0x20, 0x4B, 0xFE, 0x78, 0x00,
    0x49, 0xFC, 0x49, 0x04, 0x49, 0xFC, 0x79, 0x04, 0x49, 0xFC, 0x41, 0x04, 0x01, 0x0C, 0x01, 0x08 }, /*"晴",0*/
  { 0x00, 0x00, 0x00, 0x00, 0x1F, 0xF8, 0x00, 0x00, 0x00, 0x00, 0x00, 0x00, 0x7F, 0xFE, 0x7F, 0xFE,
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    0x6B, 0xFC, 0x64, 0x20, 0x6C, 0x20, 0x7B, 0xFE, 0x60, 0x20, 0x60, 0x20, 0x60, 0x20, 0x00, 0x20 }, /*"阵",1*/
};

const unsigned char Symbol_Arr[3][32] = {
  { 0x00, 0x00, 0x20, 0x00, 0x50, 0x00, 0x50, 0xF0, 0x23, 0x0C, 0x02, 0x04, 0x06, 0x00, 0x04, 0x00,
    0x04, 0x00, 0x04, 0x00, 0x04, 0x04, 0x06, 0x04, 0x03, 0x0C, 0x01, 0xF8, 0x00, 0x00, 0x00, 0x00 }, /*"℃",0*/
  { 0x00, 0x00, 0x20, 0x00, 0x50, 0x00, 0x53, 0xFE, 0x23, 0x00, 0x03, 0x00, 0x03, 0x00, 0x03, 0x00,
    0x03, 0xF8, 0x03, 0x00, 0x03, 0x00, 0x03, 0x00, 0x03, 0x00, 0x00, 0x00, 0x00, 0x00, 0x00, 0x00 }, /*"℉",1*/
  { 0x00, 0x00, 0x00, 0x00, 0x00, 0x04, 0x00, 0x38, 0x01, 0xC0, 0x0E, 0x00, 0x30, 0x00, 0x0E, 0x00,
    0x01, 0xC0, 0x20, 0x38, 0x1C, 0x04, 0x03, 0x80, 0x00, 0x70, 0x00, 0x0C, 0x00, 0x00, 0x00, 0x00 }, /*"≤",2*/
};

const unsigned char Weather_IconArr[19][32] = {
  { 0x00, 0x00, 0x00, 0x00, 0x00, 0x00, 0x01, 0xf0, 0x0f, 0xf8, 0x1f, 0xf8, 0x3f, 0xfc, 0x7f, 0xfe,
    0xff, 0xff, 0xff, 0xff, 0xff, 0xff, 0x7f, 0xfe, 0x3f, 0xfe, 0x00, 0x00, 0x00, 0x00, 0x00, 0x00 },  //多云
  {
    0x00, 0x00, 0x00, 0x00, 0x00, 0x00, 0x03, 0x80, 0x0f, 0xc0, 0x0f, 0xc0, 0x1f, 0xf0, 0x3f, 0xfc,
    0x3f, 0xfc, 0x3f, 0xfc, 0x1f, 0xf8, 0x00, 0x00, 0x00, 0x00, 0x00, 0x00, 0x00, 0x00, 0x00, 0x00 },  //闪电
  {
    0x00, 0x00, 0x00, 0x00, 0x00, 0x00, 0x03, 0x80, 0x0f, 0xc0, 0x0f, 0xc0, 0x1f, 0xf0, 0x3f, 0xfc,
    0x3f, 0xfc, 0x3f, 0xfc, 0x1f, 0xf8, 0x00, 0x00, 0x00, 0x00, 0x00, 0x00, 0x00, 0x00, 0x00, 0x00 },  //大雪
  {
    0x00, 0x00, 0x00, 0x00, 0x00, 0x00, 0x3f, 0xfc, 0x00, 0x00, 0x3f, 0xfc, 0x00, 0x00, 0x3f, 0xfc,
    0x00, 0x00, 0x00, 0x40, 0x00, 0x00, 0x09, 0x10, 0x00, 0x00, 0x02, 0x40, 0x00, 0x00, 0x00, 0x00 },  //雾霾
  {
    0x00, 0x00, 0x00, 0x00, 0x00, 0x00, 0x03, 0x80, 0x0f, 0xc0, 0x0f, 0xc0, 0x1f, 0xf0, 0x3f, 0xfc,
    0x3f, 0xfc, 0x3f, 0xfc, 0x1f, 0xf8, 0x00, 0x00, 0x00, 0x00, 0x00, 0x00, 0x00, 0x00, 0x00, 0x00 },  //雾
  {
    0x00, 0x00, 0x00, 0x00, 0x00, 0x00, 0x03, 0x80, 0x0f, 0xc0, 0x0f, 0xc0, 0x1f, 0xf8, 0x3f, 0xfc,
    0x3f, 0xfc, 0x3f, 0xfc, 0x1f, 0xf8, 0x00, 0x00, 0x08, 0x10, 0x08, 0x10, 0x00, 0x00, 0x00, 0x00 },  //雨夹雪
  {
    0x00, 0x00, 0x00, 0x00, 0x00, 0x00, 0x00, 0x00, 0x01, 0xe0, 0x00, 0xf0, 0x0f, 0x70, 0x1f, 0xbe,
    0x3f, 0x8f, 0x7f, 0xf7, 0xff, 0xfb, 0xff, 0xf8, 0xff, 0xf8, 0x7f, 0xf8, 0x00, 0x00, 0x00, 0x00 },  //阴
  {
    0x00, 0x00, 0x00, 0x00, 0x00, 0x00, 0x03, 0x80, 0x0f, 0xc0, 0x0f, 0xc0, 0x1f, 0xf8, 0x3f, 0xfc,
    0x3f, 0xfc, 0x3f, 0xfc, 0x1f, 0xf8, 0x00, 0x00, 0x09, 0x90, 0x09, 0x90, 0x00, 0x00, 0x00, 0x00 },  //大雨
  {
    0x00, 0x00, 0x00, 0x00, 0x00, 0x00, 0x03, 0x80, 0x07, 0xc0, 0x0f, 0xc0, 0x1f, 0xf8, 0x3f, 0xfc,
    0x3f, 0xfc, 0x3f, 0xfc, 0x1f, 0xf8, 0x00, 0x00, 0x09, 0x80, 0x0d, 0xb0, 0x00, 0x00, 0x00, 0x00 },  //冰雹
  {
    0x00, 0x00, 0x00, 0x00, 0x00, 0x00, 0x34, 0x00, 0x34, 0x18, 0x2c, 0x30, 0x24, 0x60, 0x00, 0xc0,
    0x01, 0x80, 0x03, 0x00, 0x06, 0x18, 0x0c, 0x18, 0x18, 0x3c, 0x10, 0x2c, 0x00, 0x00, 0x00, 0x00 },  //未知
  {
    0x00, 0x00, 0x00, 0x00, 0x00, 0x20, 0x01, 0x04, 0x00, 0x7c, 0x00, 0x78, 0x0f, 0x7f, 0x1f, 0xb8,
    0x3f, 0x88, 0x7f, 0xf0, 0xff, 0xf8, 0xff, 0xf8, 0xff, 0xf8, 0x7f, 0xf8, 0x00, 0x00, 0x00, 0x00 },  //多云
  {
    0x00, 0x00, 0x00, 0x10, 0x00, 0x04, 0x00, 0x02, 0x00, 0x02, 0x00, 0x02, 0x3f, 0xc2, 0x00, 0x04,
    0x0f, 0xf0, 0x00, 0x00, 0x00, 0xc0, 0x00, 0x20, 0x00, 0x00, 0x00, 0x20, 0x00, 0x40, 0x00, 0x00 },  //风
  {
    0x00, 0x00, 0x00, 0x00, 0x20, 0x04, 0x10, 0x08, 0x03, 0xc0, 0x07, 0xe0, 0x0f, 0xf0, 0x0f, 0xf0,
    0x0f, 0xf0, 0x0f, 0xf0, 0x07, 0xe0, 0x03, 0xc0, 0x10, 0x08, 0x20, 0x04, 0x01, 0x00, 0x00, 0x00 },  //晴
  {
    0x00, 0x00, 0x01, 0x00, 0x03, 0x80, 0x03, 0x80, 0x07, 0xc0, 0x07, 0xc0, 0x0f, 0xe0, 0x0f, 0xe0,
    0x0f, 0xf0, 0x1f, 0xf0, 0x1f, 0xf8, 0x3f, 0xf8, 0x3c, 0x7c, 0x70, 0x1c, 0x60, 0x06, 0x00, 0x00 },  //风力
  {
    0xc0, 0x00, 0x70, 0x00, 0x7c, 0x0e, 0x7f, 0xfe, 0x78, 0x4c, 0x60, 0x40, 0x00, 0x40, 0x00, 0x40,
    0x00, 0xc0, 0x00, 0xe0, 0x00, 0xe0, 0x00, 0xe0, 0x00, 0xe0, 0x00, 0xe0, 0x00, 0xe0, 0x00, 0xc0 },  //风向
  {
    0x00, 0x00, 0x00, 0x00, 0x00, 0x00, 0x00, 0x30, 0x00, 0x78, 0x00, 0xd0, 0x01, 0xa0, 0x03, 0x40,
    0x0e, 0x80, 0x1d, 0x10, 0x12, 0x38, 0x1e, 0x28, 0x0c, 0x38, 0x00, 0x00, 0x00, 0x00, 0x00, 0x00 },  //湿度
  {
    0x03, 0xc0, 0x03, 0xc0, 0x06, 0x60, 0x06, 0x60, 0x06, 0x60, 0x06, 0x60, 0x06, 0x60, 0x06, 0x60,
    0x0c, 0x20, 0x0d, 0xb0, 0x19, 0x90, 0x1b, 0xd8, 0x19, 0x98, 0x0c, 0x30, 0x07, 0xe0, 0x03, 0xc0 },  //温度
  {
    0x00, 0x00, 0x01, 0x80, 0x03, 0xc0, 0x07, 0xe0, 0x07, 0x60, 0x0f, 0x70, 0x0f, 0x70, 0x1f, 0x78,
    0x1f, 0x78, 0x3f, 0x7c, 0x7f, 0xfe, 0x7f, 0xfe, 0xff, 0x7f, 0xff, 0xff, 0x7f, 0xff, 0x00, 0x00 },  //警告
  {
    0x00, 0x00, 0x3f, 0x80, 0x00, 0x00, 0x00, 0x00, 0x0a, 0x00, 0x0a, 0xc0, 0x00, 0x70, 0x00, 0x0e,
    0x0a, 0x06, 0x00, 0xe0, 0x00, 0xc0, 0x0e, 0xe0, 0x0a, 0xc0, 0x0a, 0x00, 0x7f, 0xfe, 0x00, 0x00  //城市
  }
};

const String Chinese_index[CHINESEARRLEN] = { "晴", "云", "风", "阴", "雨", "雾", "霾", "雷", "冰", "雪", "尘", "特", "大", "中", "小", "静", "暴", "夹",
                                              "东", "南", "西", "北", "无", "不", "定", "多", "转", "阵" };

const String Symbol_index[3] = { "℃", "℉", "≤" };

uint8_t celsiusChar[8] = { 0x07, 0x05, 0x07, 0x00, 0x1C, 0x22, 0x1C, 0x00 };
uint8_t smileyChar[8] = { 0x00, 0x00, 0x0A, 0x00, 0x00, 0x11, 0x0E, 0x00 };
uint8_t crySimpleChar[8] = { 0x00, 0x00, 0x0A, 0x00, 0x0E, 0x11, 0x00, 0x00 };


IPAddress ip;
WiFiUDP ntpUDP;
NTPClient tc(ntpUDP, NTP_SERVERS[4], ZONE, 60000);

WiFiClient wc;
PubSubClient pc(wc);

// 时钟
ThreeWire Wiret(DS_DATA, DS_CLK, DS_RST);
RtcDS1302<ThreeWire> Rtc(Wiret);
RtcDateTime compiled = RtcDateTime(__DATE__, __TIME__);

Adafruit_SSD1306 display(OLED_WIDTH, OLED_HEIGHT, &Wire, OLED_RESET);
LiquidCrystal_I2C lcd(0x27, 16, 2);

boolean tempMessage = false;
int timecount = 0;
float temperature, humidity;
boolean warnFlag = false;

// 天气
uint8_t pageflag = 0;
uint8_t weather_textlen = 0;
int Weather_updateCount;
bool WeatherFlag = false;
uint8_t weather_iconindex;
uint8_t weather_statusindexarr[WEATHERTEXTLEN], weather_directionarr[4];

bool swFlag = false;
bool dot = false;
bool blforce = false;
uint8_t swOBJ;
uint8_t dateAVBPOS = 0;

String Weather_Status;
String Weather_Temperature;
String Weather_Humidity;
String Weather_WindPower;
String Weather_WindDirection;
String Weather_ReportTime;

String RequestURL = String(API_REQUESTURL) + "city=" + String(CITY_CODE) + "&key=" + String(API_KEY);




void MQTTCallBack(char *topic, byte *payload, unsigned int len) {
  String msg = "";
  float dhtvalue = 0.0;
  boolean istemperature = false;


  for (unsigned int i = 0; i < len; i++) {
    msg += (char)payload[i];  
  }

  Serial.println("\n------------------------");
  Serial.println("Received Msg: " + msg);
  Serial.println("Topic: " + String(topic));


  if (msg.length() > 2 && msg[0] == '>') { 
    tempMessage = true;

    istemperature = (msg[1] == 'T') ? true : false;

    String valueStr = msg.substring(2);  
    dhtvalue = atof(valueStr.c_str());   

    Serial.println("Parsed Value: " + String(dhtvalue, 1));  
  } else {
    tempMessage = false;
    dhtvalue = 0.0;
  }

//（错误值253
  if (istemperature) {
    if (dhtvalue >= 253) {  
      pc.publish(DHT11_TOPIC, "~GET_TEMP");
      Serial.println("Temp read error, request new data");
    } else {
      temperature = dhtvalue == 0 ? temperature :dhtvalue; 
      Serial.println("Updated Temperature: " + String(temperature, 1));
    }
  } else {
    if (dhtvalue >= 253) { 
      pc.publish(DHT11_TOPIC, "~GET_HUM");
      Serial.println("Hum read error, request new data");
    } else {
      humidity = dhtvalue==0?humidity : dhtvalue;  
      Serial.println("Updated Humidity: " + String(humidity, 1));
    }
  }


  Serial.println("Massage: " + String(dhtvalue, 1));
  Serial.println("Topic: " + String(topic));
  Serial.println("------------------------");
}

void Wifi_connect() {
  int count = 0;
  WiFi.mode(WIFI_STA);
  WiFi.disconnect();
  WiFi.begin(WIFI_SSID, WIFI_PASSWORD);
  Serial.println("Connect to: \n\tSSID:" + String(WIFI_SSID) + "\n\tPassWord:" + String(WIFI_PASSWORD));
  while (WiFi.status() != WL_CONNECTED) {
    Serial.print('.');
    delay(1000);
    count++;
  }

  Serial.println("\nConnect to " + String(WIFI_SSID) + " Successful\n");
  Serial.println("\nMAC: " + WiFi.macAddress() + "\nIP: " + WiFi.localIP().toString() + "\nUsing Time:" + count + "s");
  display.setCursor(0, 10);
  display.printf("IP: %s \n ", WiFi.localIP().toString().c_str());
  display.setCursor(0, 20);
  display.printf("Using: %d S", count);
  display.display();
}

uint8_t MQTT_connect() {
  String data = "Hello Relay " + WiFi.macAddress() + " Started";

  if (WiFi.status() != WL_CONNECTED)
    return -1;
  if (!pc.connect(WiFi.macAddress().c_str(), MQTT_USER, MQTT_PASSWORD)) {
    Serial.println("MQTT Readly");
    return -1;
  }
  pc.subscribe(MQTT_TOPIC);
  pc.subscribe(DHT11_TOPIC);

  Serial.println("Topic: " + String(MQTT_TOPIC));

  pc.publish(MQTT_TOPIC, data.c_str());

  pc.setCallback(MQTTCallBack);

  Serial.println("Connect MQTT Server " + String(MQTT_SERVER_IP) + " Success");

  // 获取
  pc.publish(DHT11_TOPIC, "~GET_TEMP");
  pc.publish(DHT11_TOPIC, "~GET_HUM");

  return 1;
}

/*天气相关修改START*/
void displayDrawCharacter(int x, int y, const unsigned char *data) {
  for (int i = 0; i < 16; i++) {
    for (int j = 0; j < 8; j++) {
      if (data[i * 2] & (0x80 >> j)) {
        display.drawPixel(x + j, y + i, WHITE);
      }
    }
    for (int j = 0; j < 8; j++) {
      if (data[i * 2 + 1] & (0x80 >> j)) {
        display.drawPixel(x + j + 8, y + i, WHITE);
      }
    }
  }
}

//目标字符串，映射数组，映射数组长度，中文是否，索引数组，索引长度
uint8_t getMapArr_index(String ch, const String arr[], uint8_t arrSize, bool ischinese, uint8_t *indices, uint8_t maxIndices) {
  uint8_t foundCount = 0;
  int i = 0;

  while (i < ch.length() && foundCount < maxIndices) {
    // 提取当前字符（处理UTF-8多字节字符）
    char c = ch.charAt(i);
    int charBytes = 1;  //中文占位

    if ((c & 0xF8) == 0xF0) charBytes = 4;
    else if ((c & 0xF0) == 0xE0) charBytes = 3;
    else if ((c & 0xE0) == 0xC0) charBytes = 2;

    // 提取完整的字符
    String currentChar = "";
    for (int j = 0; j < charBytes && i + j < ch.length(); j++) {
      currentChar += ch.charAt(i + j);
    }

    bool found = false;
    for (uint8_t idx = 0; idx < arrSize; idx++) {
      if (arr[idx] == currentChar) {
        indices[foundCount++] = idx;
        found = true;
        break;
      }
    }

    // 移动到下一个字符
    i += charBytes;
  }

  return foundCount;
}

void getAPIData(String url) {
  Serial.println(url);
  if (WiFi.status() == WL_CONNECTED) {
    HTTPClient http;
    Serial.println("http begin");
    http.begin(wc, url);
    Serial.println("Get api");
    int Rcode = http.GET();

    if (Rcode > 0) {
      if (Rcode = HTTP_CODE_OK) {
        Serial.printf("Code: %d Get Weather Successfully\n", Rcode);
        String payload = http.getString();
        Serial.println(payload);
        getWeatherInfofromJson(payload);
      } else {
        Serial.printf("err %s\n", http.errorToString(Rcode).c_str());
      }
      http.end();
    } else {
      Serial.println(Rcode);
      Serial.println(http.getString());
    }
  }
}

void getWeatherInfofromJson(String returndata) {

  const size_t capacity = 9 * JSON_ARRAY_SIZE(9) + 9 * JSON_OBJECT_SIZE(9) + 64;
  DynamicJsonDocument doc(capacity);
  deserializeJson(doc, returndata);
  JsonObject obj = doc["lives"][0];
  Weather_Status = obj["weather"].as<String>();
  Weather_Temperature = obj["temperature"].as<String>();
  Weather_WindDirection = obj["winddirection"].as<String>();
  Weather_WindPower = obj["windpower"].as<String>();
  Weather_Humidity = obj["humidity"].as<String>();
  Weather_ReportTime = obj["reporttime"].as<String>();

  // 此处获取文字与图片索引
  for (uint8_t i = 0; i < WEATHERTEXTLEN; i++) {
    uint8_t count = getMapArr_index(Weather_Status, Chinese_index, CHINESEARRLEN, Chinese_Arr, weather_statusindexarr, WEATHERTEXTLEN);
    if (count > CHINESEARRLEN) {
      weather_statusindexarr[i] = 255;
    }
  }

  for (uint8_t i = 0; i < 4; i++) {
    uint8_t count = getMapArr_index(Weather_WindDirection, Chinese_index, CHINESEARRLEN, Chinese_Arr, weather_directionarr, 4);
    if (count > 4) {
      weather_directionarr[i] = 255;
    }
  }

  WeatherFlag = true;
}

/*天气相关修改END*/

void WriteData(int sw, uint8_t pos) {
  EEPROM.write(pos, sw);
  EEPROM.commit();
}

/*获取状态和写入状态*/
uint8_t ReadData(uint8_t pos) {
  return EEPROM.read(pos);
}

void LED_Flash(int hz) {
  uint8_t Ti = (hz / 60) * 1000;
  for (uint8_t i = 0; i <= hz; i++) {
    digitalWrite(LED, 1);
    delay(Ti);
    digitalWrite(LED, 0);
    delay(Ti);
  }
}

void NtpUpdate() {
  tc.update();
  Serial.println(tc.getFormattedTime());
  setTime(tc.getEpochTime());
  RtcDateTime current = RtcDateTime(year() < 2025 ? 2006 : year(), month(), day(), hour(), minute(), second());
  Serial.printf("NTP-Get: y:%d m:%d d:%d h:%d m:%d S:%d\n", year(), month(), day(), hour(), minute(), second());
  Rtc.SetDateTime(current);
  RtcDateTime now = Rtc.GetDateTime();
  Serial.printf("Rtc-Get: y:%d m:%d d:%d h:%d m:%d S:%d\n", now.Year(), now.Month(), now.Day(), now.Hour(), now.Minute(), now.Second());
}

String Fixxint(int value) {
  if (value < 10) {
    return "0" + String(value);
  } else {
    return String(value);
  }
}

String Fixxfloat(float value) {
  if (value < 10) {
    return "0" + String(value);
  } else {
    return String(value);
  }
}

void initialization() {
  pinMode(LED, OUTPUT);

  //天气
  Wire.begin(SDA, SCL);
  display.begin(SSD1306_SWITCHCAPVCC, OLED_ADDR);
  display.clearDisplay();
  display.setTextColor(WHITE);
  display.setTextSize(1);

  // Oclock
  tc.begin();
  Rtc.Begin();
  Rtc.SetIsWriteProtected(false);
  Rtc.SetIsRunning(true);

  lcd.init();
  lcd.backlight();

  // 字符
  lcd.createChar(0, celsiusChar);
  lcd.createChar(1, smileyChar);
  lcd.createChar(2, crySimpleChar);
}

void setzero() {
  for (uint8_t i = 0; i < 8; i++) {
    WriteData(0, i);
  }
}

String getWeek() {
  RtcDateTime now = Rtc.GetDateTime();
  switch (now.DayOfWeek()) {
    case 1: return "SUN"; break;
    case 2: return "MON"; break;
    case 3: return "WED"; break;
    case 4: return "THU"; break;
    case 5: return "FRI"; break;
    case 6: return "SAT"; break;
    case 7: return "SUN"; break;
    default: return "UNK"; break;
  }
}

////////////////////////////////////////////////////////////
void setup() {


  // lcd.setCursor(0, 0);
  // lcd.println("initialization");
  // lcd.setCursor(0, 1);
  // lcd.println("initialization");
  EEPROM.begin(16);
  Serial.begin(9600);
  initialization();
  // MQTT
  pc.setServer(MQTT_SERVER_IP, MQTT_PORT);

  display.setCursor(0, 0);
  display.printf("Connect to: %s", WIFI_SSID);
  display.display();

  Wifi_connect();
  pc.connect(WiFi.macAddress().c_str());
  display.setCursor(0, 30);
  display.printf("Exiting:");
  display.setCursor(25, 40);
  for (uint8_t i = 6; i > 0; i--) {
    display.printf("%d ", i);
    display.display();
    delay(500);
  }
  display.clearDisplay();
  display.setTextSize(1);
  display.setCursor(25, 20);
  display.print("Booting.....");
  display.display();
  tone(Buzzer, 456);
  delay(200);
  tone(Buzzer, 256);
  delay(200);
  noTone(Buzzer);
  tone(Buzzer, 500);
  delay(200);
  tone(Buzzer, 256);
  delay(200);
  noTone(Buzzer);

  getAPIData(RequestURL);
  NtpUpdate();
  setzero();
}

void loop() {
  /*天气相关模块*/
  //更新与计时器


  timecount++;
  Serial.printf("\nTimeCount:%d\n", timecount);
  if (timecount % 5 == 0) {
    pageflag++;
    if (pageflag > 2) pageflag = 1;
  }

  if (timecount >= 3600 * WEATHERUPDATEHOURSDELAY) {
    timecount = 0;
    getAPIData(RequestURL);
  }

  // 没有天气持续获取getAPIData(RequestURL)
  if (!WeatherFlag) {
    getAPIData(RequestURL);
  }

  if (pageflag == 1 && WeatherFlag) {
    display.clearDisplay();
    display.setCursor(3, 3);
    display.printf("%s", Weather_ReportTime.c_str());
    displayDrawCharacter(2, 15, Weather_IconArr[10]);
    display.setCursor(22, 20);
    display.printf("Weather:");
    for (uint8_t i = 0; i < WEATHERTEXTLEN; i++) {
      if (weather_statusindexarr[i] < CHINESEARRLEN) {
        if (weather_statusindexarr[i] == weather_statusindexarr[i + 1]) i++;
        displayDrawCharacter(70 + (i * 18), 15, Chinese_Arr[weather_statusindexarr[i]]);
      }
    }

    displayDrawCharacter(2, 33, Weather_IconArr[16]);
    display.setCursor(22, 35);
    display.printf("Temper: %s", Weather_Temperature);
    displayDrawCharacter(90, 30, Symbol_Arr[0]);

    displayDrawCharacter(2, 48, Weather_IconArr[15]);
    display.setCursor(22, 55);
    display.printf("Humidity: %s %%", Weather_Humidity);
    display.fillRect(123, 0, 5, (timecount % 5) * 12.8, WHITE);
  }

  /*Page 2*/
  if (pageflag == 2 && WeatherFlag) {
    display.clearDisplay();
    display.setCursor(3, 3);
    display.printf("%s", Weather_ReportTime.c_str());
    displayDrawCharacter(2, 15, Weather_IconArr[13]);
    display.setCursor(22, 20);
    String WindPower = "";
    for (uint8_t i = 0; i < Weather_WindPower.length(); i++) {
      if (Weather_WindPower.charAt(i) >= '0' && Weather_WindPower.charAt(i) <= '9') {
        WindPower += Weather_WindPower.charAt(i);
      }
    }
    if (WindPower.charAt(0) <= '3') {
      display.printf("WindPower: <=%s", WindPower);
    } else {
      display.printf("WindPower: %s", WindPower);
    }

    displayDrawCharacter(2, 33, Weather_IconArr[14]);
    display.setCursor(22, 38);
    display.printf("Wind.D:");
    for (uint8_t i = 0; i < 4; i++) {
      if (weather_directionarr[i] < CHINESEARRLEN) {
        if (weather_directionarr[i] == weather_directionarr[i + 1]) i++;
        displayDrawCharacter(65 + (i * 18), 33, Chinese_Arr[weather_directionarr[i]]);
      }
    }

    displayDrawCharacter(2, 48, Weather_IconArr[18]);
    display.setCursor(22, 55);
    display.printf("CityCode: %s", CITY_CODE);
    display.fillRect(123, 0, 5, (timecount % 5) * 12.8, WHITE);
  }

  // if (pageflag == 3) {
  //   display.clearDisplay();
  //   display.fillRect(123, 0, 5, (timecount % 5) * 12.8, WHITE);
  // }

  if (!WeatherFlag) {
    displayDrawCharacter(2, 25, Weather_IconArr[17]);
    display.setCursor(25, 28);
    display.print("No Weather Data!");
  }
  display.display();

  /*旧模块*/
  if (timecount % 100 == 0) {
    pc.publish(DHT11_TOPIC, "~GET_TEMP");
    pc.publish(DHT11_TOPIC, "~GET_HUM");
  }

  RtcDateTime now = Rtc.GetDateTime();
  if (WiFi.status() != WL_CONNECTED) {
    Serial.println();
    Serial.println("WiFi is break reconnect ... ");
    Wifi_connect();
  } else {
    if (!pc.connected()) {
      MQTT_connect();
    } else {
      pc.loop();
    }
  }


  // ntp修正
  if (now.Year() < 2025) {
    NtpUpdate();
  }

  // Serial.printf(
  //   ">%d%s%s^%s%s%s^%5s^%5s^%d\n",
  //   now.Year(),
  //   Fixxint(now.Month()),
  //   Fixxint(now.Day()),
  //   Fixxint(now.Hour()),
  //   Fixxint(now.Minute()),
  //   Fixxint(now.Second()),

  //   Fixxfloat(temperature),
  //   Fixxfloat(humidity),
  //   warnFlag);

  lcd.clear();
  lcd.setCursor(0, 0);
  if (now.Hour() < 10) dateAVBPOS++;
  if (now.Minute() < 10) dateAVBPOS++;
  if (now.Month() < 10) dateAVBPOS++;
  if (now.Day() < 10) dateAVBPOS++;
  if (now.Hour() < 10) dateAVBPOS++;
  if (dateAVBPOS > 2) {
    lcd.printf("%d-%d-%d %d:%d:%d", now.Year(), now.Month(), now.Day(), now.Hour(), now.Minute(), now.Second());
  } else {
    if (dot) {
      lcd.printf("%d-%d-%d %d:%d", now.Year(), now.Month(), now.Day(), now.Hour(), now.Minute());
    } else {
      lcd.printf("%d-%d-%d %d %d", now.Year(), now.Month(), now.Day(), now.Hour(), now.Minute());
    }
  }
  // 白天关闭背光

  if ((now.Hour() < 16 && now.Hour() > 8) && !blforce) {
    lcd.noBacklight();
  }

  dot = !dot;

  lcd.setCursor(0, 1);

  lcd.printf("%04.1fC %4.1f%% %3s", temperature, humidity, getWeek());
  lcd.setCursor(4, 1);
  lcd.printByte(0);

  Serial.println(humidity);
  // 舒适区判
  if (temperature >= 22.0 && temperature <= 26.0) {
    if (humidity >= 40.0 && humidity <= 60.0) {
      lcd.setCursor(15, 1);
      lcd.printByte(1);
    }
  } else {
    lcd.setCursor(15, 1);
    lcd.printByte(2);
  }
  // 强制背光
  if (digitalRead(BackLightForce)) {
    blforce = true;
    lcd.backlight();
  }
  delay(1000);
}
///////////////////////////////////////////////////////////